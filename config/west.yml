## config/west.yml
```yaml
manifest:
  remotes:
    - name: waterfowlzmk
      url-base: https://github.com/DiegoDoreto
  projects:
    - name: waterfowlzmk
      remote: zmk
      revision: waterfowl-encoders
      import: app/west.yml
  self:
    path: config
```
